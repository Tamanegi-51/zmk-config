## config/west.yml
```yaml
manifest:
  remotes:
    - name: zmk
      url-base: https://github.com/zmkfirmware
  projects:
    - name: zmk
      remote: zmk
      revision: main
      path: zmk
  self:
    path: config
```
